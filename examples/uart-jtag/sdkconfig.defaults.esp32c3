## test/Kconfig
```kconfig
menu "i2s_mic tests"

    config I2S_MIC_TEST_GPIO_BCK
        int "I2S BCK (SCK) GPIO"
        default 7 if IDF_TARGET_ESP32C3 || IDF_TARGET_ESP32C6
        default 16
        help
            Bit clock pin. No microphone is required for the tests: the
            ESP32 drives the I2S clocks itself, so DMA buffers complete on
            time even with nothing connected. If a mic is wired, use its
            pins so nothing else is driven on them.

    config I2S_MIC_TEST_GPIO_WS
        int "I2S WS GPIO"
        default 8 if IDF_TARGET_ESP32C3 || IDF_TARGET_ESP32C6
        default 17

    config I2S_MIC_TEST_GPIO_DATA
        int "I2S SD (data in) GPIO"
        default 9 if IDF_TARGET_ESP32C3 || IDF_TARGET_ESP32C6
        default 18

    config I2S_MIC_TEST_PORT
        int "I2S port"
        default 0

    config I2S_MIC_TEST_CYCLES
        int "Start/stop cycles in the cycle test"
        default 1000
        range 10 100000

endmenu
```

## test_app/main/Kconfig.projbuild
```kconfig
menu "i2s_mic test app"

    config I2S_MIC_TEST_APP_INTERACTIVE
        bool "Show the Unity menu instead of running every test"
        default n
        help
            Off: every test runs on boot and a summary is printed. On: the
            Unity menu appears on the serial monitor so you can pick tests
            by number or tag (e.g. [flow]).

endmenu
```
